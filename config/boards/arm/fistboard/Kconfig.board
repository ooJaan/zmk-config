## config/boards/arm/fistboard/Kconfig.board
```kconfig
# fistboard board configuration

# Copyright (c) 2020 The ZMK Contributors
# SPDX-License-Identifier: MIT

config BOARD_FISTBOARD
	bool "fistboard"
	depends on SOC_NRF52840_QIAA
```

## config/boards/shields/fistboard/Kconfig.defconfig
```kconfig
if SHIELD_FISTBOARD_LEFT

config ZMK_KEYBOARD_NAME
	default "fistboard"

config ZMK_SPLIT_BLE_ROLE_CENTRAL
	default y

endif

if SHIELD_FISTBOARD_LEFT || SHIELD_FISTBOARD_RIGHT

config ZMK_SPLIT
	default y
 

endif # ZMK_DISPLAY


endif
```

## config/boards/shields/fistboard/Kconfig.shield
```kconfig
#
# Copyright (c) 2020 Pete Johanson
# SPDX-License-Identifier: MIT

config SHIELD_FISTBOARD_LEFT
	def_bool $(shields_list_contains,fistboard_left)

config SHIELD_FISTBOARD_RIGHT
	def_bool $(shields_list_contains,fistboard_right)
```
