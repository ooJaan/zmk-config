/*
 * Copyright (c) 2020 Pete Johanson
 *
 * SPDX-License-Identifier: MIT
 */

#include "fistboard.dtsi"

&kscan0 {
	col-gpios
		= <&acn 4 GPIO_ACTIVE_HIGH>
		, <&acn 30 GPIO_ACTIVE_HIGH>
		, <&acn 2 GPIO_ACTIVE_HIGH>
		, <&acn 9 GPIO_ACTIVE_HIGH>
		, <&acn 15 GPIO_ACTIVE_HIGH>
		, <&acn 13 GPIO_ACTIVE_HIGH>
		;
	row-gpios
		= <&acn 17 (GPIO_ACTIVE_HIGH | GPIO_PULL_DOWN)>
		, <&acn 31 (GPIO_ACTIVE_HIGH | GPIO_PULL_DOWN)>
		, <&acn 3 (GPIO_ACTIVE_HIGH | GPIO_PULL_DOWN)>
		, <&acn 8 (GPIO_ACTIVE_HIGH | GPIO_PULL_DOWN)>
		;
		
};

nice_view_spi: &spi0 {
    compatible = "nordic,nrf-spim";
    sck-pin = <29>;
    mosi-pin = <28>;
    miso-pin = <12>;
    cs-gpios = <&acn 26 GPIO_ACTIVE_HIGH>;
};
