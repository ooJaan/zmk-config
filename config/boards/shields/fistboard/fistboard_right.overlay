/*
 * Copyright (c) 2020 Pete Johanson
 *
 * SPDX-License-Identifier: MIT
 */

#include "fistboard.dtsi"

&default_transform {
	col-offset = <6>;
};

&kscan0 {
	col-gpios
		= <&acn 12 GPIO_ACTIVE_HIGH>
		, <&acn 24 GPIO_ACTIVE_HIGH>
		, <&acn 2 GPIO_ACTIVE_HIGH>
		, <&acn 6 GPIO_ACTIVE_HIGH>
		, <&acn 29 GPIO_ACTIVE_HIGH>
		, <&acn 31 GPIO_ACTIVE_HIGH>
		;

	row-gpios
		= <&acn 28 (GPIO_ACTIVE_HIGH | GPIO_PULL_DOWN)>
		, <&acn 13 (GPIO_ACTIVE_HIGH | GPIO_PULL_DOWN)>
		, <&acn 30 (GPIO_ACTIVE_HIGH | GPIO_PULL_DOWN)>
		, <&acn 27 (GPIO_ACTIVE_HIGH | GPIO_PULL_DOWN)>
		;
		
};
